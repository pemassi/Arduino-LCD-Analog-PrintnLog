/*//////////////////////////////////////////////////////////////////////////////////////////////////////////////////////////////////////////////////////
회로구성을 위한 준비
//////////////////////////////////////////////////////////////////////////////////////////////////////////////////////////////////////////////////////
	- SD카드 회로구성
		SD카드는 SPI통신을 하므로 아두이노보드에서 다음 핀을 우선적으로 할당 할것 
			 ** MOSI - pin 11
			 ** MISO - pin 12
			 ** SLK  - pin 13
			 ** CS   - pin 4

	- LCD 회로구성
		LCD 보드는 2개의 설정핀과 4개의 데이터핀을 사용하는데 모두 6개의 디지털 핀이 필요하다. 
		아래의 LiquidCrystal lcd()크래스에서 보듯이 2,3,5,6,7,8번 핀으로 설정했으며 이는 우선적으로 할당한 sd카드 핀을 피하기 위해 임의로 설정한 핀이다.
		핀번호는 차례대로 rs, e, d4, d5, d6, d7 순서대로 (2, 3, 5, 6, 7, 8);로 세팅한다.
		sd카드를 사용하지 않는다면 다른 핀을 사용해도 상관없다. 단 특별한 경우를 제외하면 각 회로보드의 회로구성은 다른 회로보드의 사용핀과 겹쳐사용하지 않는다.
	*/

/*//////////////////////////////////////////////////////////////////////////////////////////////////////////////////////////////////////////////////////
프로그램에 필요한 전처리자와 클래스 선언
//////////////////////////////////////////////////////////////////////////////////////////////////////////////////////////////////////////////////////*/
#include <SimpleTimer.h>            	 	// 사용자 timer를 사용하기 위한 전처리 프로그램
#include <SD.h>                      		// sd카드를 사용하기 위한 전처리 프로그램
#include <LiquidCrystal.h>           		// lcd를 사용하기 위한 전처리 프로그램

File myFile;                         			// sd카드를 엑세스하기 위한 File클래스 선언 - SD카드에 있는 파일과 연결해주는 역할을 해준다.
LiquidCrystal lcd(2, 3, 5, 6, 7, 8); 			// lcd를 사용하기 위한 LiquidCrystal클래스 선언
SimpleTimer timer;                    		// 타이머를 사용하기 위한 클래스 선언

/*//////////////////////////////////////////////////////////////////////////////////////////////////////////////////////////////////////////////////////
센싱에 필요한 변수 선언
//////////////////////////////////////////////////////////////////////////////////////////////////////////////////////////////////////////////////////*/
const int sensorOut = A0;            		// sensorOut변수를 const를 붙여 선언하면 변수에 저장된 값이 상수화 되어 초기화된 값이 이후에 변경되지 않는다.
unsigned int Sensor_Count = 1;     	  	// Sensor_Count변수는 sd카드에 저장시키는 결과값을 순서를 표현하기 위해 사용된다.
unsigned int retry_count = 0;       		// SD카드가 준비되지 않았을 때 준비시키기 위해 재시도하는 횟수를 count한다.
unsigned int sensorValue = 0;        	// A0포트를 통해 전달되는 센서값을 저장하는 변수
unsigned int return_value = 0;       		// 필터링에 의해 연산된 센서값을 저장하는 변수

/*//////////////////////////////////////////////////////////////////////////////////////////////////////////////////////////////////////////////////////
프로브에 의해 측정된 값의 필터링에 필요한 변수 선언
//////////////////////////////////////////////////////////////////////////////////////////////////////////////////////////////////////////////////////*/
unsigned int sensor_stack = 0;        	// 프로브에 의해 측정되는 센서값의 총합을 저장한다.
signed int sensor_max = 0;            	// 지정된 시간안에 측정된 센서값중 최대값을 저장한다.
signed int sensor_min = 1023;         	// 지정된 시간안에 측정된 센서값중 최소값을 저장한다.
unsigned int sensor_stack_count = 0;  	// sensor_stack에 측정값이 더해질 때마다 카운트를 한다. 초기값은 0 이다. (스택에 더해진 수의 갯수) 

/*//////////////////////////////////////////////////////////////////////////////////////////////////////////////////////////////////////////////////////
사용할 사용자 함수원형 선언
//////////////////////////////////////////////////////////////////////////////////////////////////////////////////////////////////////////////////////*/
void SD_Logging();                    		// sd카드에 저장하기 위한 기본 함수
void StacknSerial();                  		// 측정된 값을 필터링하기 위한 함수
void LCD_Print();                     		// lcd 에 결과를 출력하기 위한 함수

/*//////////////////////////////////////////////////////////////////////////////////////////////////////////////////////////////////////////////////////
아두이노 setup함수 선언 - 아두이노 전원이 켜진 후 바로 이 함수가 실행된다.
//////////////////////////////////////////////////////////////////////////////////////////////////////////////////////////////////////////////////////*/
void setup()
{
	Serial.begin(9600);	 		//시리얼통신 시작 - bitrate 9600
	pinMode(10, OUTPUT); 	//10번 핀 OUTPUT 모드로 변경
	lcd.begin(16, 2);			// LCD 초기화한다. (16x2) - LCD의 행,열 사이즈를 입력하면 된다. 

	lcd.print("Init SD Card");  // LCD 화면에 해당 문자를 출력한다.
	
	delay(1000);				// 1000ms를 기달린다.
	
	// SD카드 연결 시도(CS - 4)
	if(!SD.begin(4))							// SD.begin(CS)은 SD카드의 연결 여부를 반환한다. CS 4핀 을 사용하여 SD 카드 연결을 확인한다.
 	{

		lcd.clear();							// LCD 화면 클리어

		lcd.setCursor(0,0);					// LCD 커서를 0x0으로 이동한다.
		lcd.print("Connected Error");		// LCD에 해당 문자를 출력
		
		lcd.setCursor(0,1);					// 0x1 좌표로 커서 이동
		lcd.print("Miss SD Card");			// LCD에 해당 문자를 출력

		delay(1000);						// 1000ms를 기달린다.
		
		//SD 카드 연결 재 시도
		while(1)
		{
			// SD카드 연결 시도(CS - 4)
			if(!SD.begin(4))			// SD.begin()은 SD카드의 연결 여부를 참,거짓으로 반환한다. CS 4핀 을 사용하여 SD 카드 연결을 확인한다.
			{
				lcd.clear();						// LCD 화면 클리어

				lcd.setCursor(0,0);				// LCD 커서를 0x0으로 이동한다.
				lcd.print("Retry Connect");		// LCD에 해당 문자를 출력

				lcd.setCursor(0,1);				// LCD 커서를 0x1으로 이동한다.
				lcd.print(retry_count);			// LCD에 해당 문자를 출력 - retry_count(재 연결 시도 횟수) 
				
				lcd.setCursor(10,1);			// LCD 커서를 10x1으로 이동한다.
				lcd.print("Times");				// LCD에 해당 문자를 출력

				retry_count++;				// retry_count(재연결 시도 회수)를 1 늘린다.

				delay(1000);					// 1000ms를 기달린다.
			}
			else break;							// 재연결이 확인되었으면, While문을 빠져나온다.
		}
	}
	

	lcd.clear();					// LCD 화면 클리어
	
	lcd.print("Init Done");		// LCD에 해당 문자를 출력

	delay(1000);				// 1000ms를 기달린다.

	
	//타이머 이벤트 설정
	timer.setInterval(1000, StacknSerial); 		//"StacknSerial" 함수 이벤트를 1초마다 발생하도록 설정
	timer.setInterval(1000, LCD_Print); 		//"LCD_Print" 함수 이벤트를 1초마다 발생하도록 설정
	timer.setInterval(10000, SD_Logging); 	//"SD_Logging" 함수 이벤트를 10초마다 발생하도록 설정
	
	//자세한 센서 파일 기록을 위한 단계 (파일 이어쓰기 모드로 연다.)
	myFile = SD.open("sensor_2.txt", FILE_WRITE);		//현재 연결된 SD카드에서 파일 이어쓰기 모드(FILE_WRITE)로 
															//sensor_2.txt 파일을 열어 'myFIle'에 넣어 파일을 연결한다.		

	if(myFile) 		// 파일을 여는 데 성공 한 경우(myFile은 파일의 연결 여부를 참, 거짓으로 반환해준다)
	{
		myFile.print(Sensor_Count);		//파일에 Sensor_Count(센서 기록 횟수)를 쓴다.
		myFile.print("  -  ");				//파일에 해당 문자를 쓴다.
		myFile.close();						//파일쓰기를 마무리한다. (연결된 파일이 연결해제 된다.)
	} 
}

/*//////////////////////////////////////////////////////////////////////////////////////////////////////////////////////////////////////////////////////
아두이노 loop 함수 - setup 함수가 끝나면, 이 함수가 항상 반복된다.
//////////////////////////////////////////////////////////////////////////////////////////////////////////////////////////////////////////////////////*/
void loop()
{
	sensorValue = analogRead(sensorOut); //센서 값을 sensorValue 변수에 담는다.
	timer.run(); 								//타이머 이벤트를 위한 시간 카운트
}

/*//////////////////////////////////////////////////////////////////////////////////////////////////////////////////////////////////////////////////////
사용자 함수 원본 코드
//////////////////////////////////////////////////////////////////////////////////////////////////////////////////////////////////////////////////////*/


/*//////////////////////////////////////////////////////////////////////////////////////////////////////////////////////////////////////////////////////
SD 파일 기록 함수(10초 마다 이벤트 발생)
//////////////////////////////////////////////////////////////////////////////////////////////////////////////////////////////////////////////////////*/
void SD_Logging()
{
	// sensor.txt 파일에 필터링된 센서 값 정보를 기록 (파일 이어쓰기 모드로 연다.)
	myFile = SD.open("sensor.txt", FILE_WRITE);		//현재 연결된 SD카드에서 파일 이어쓰기 모드(FILE_WRITE)로 
														//sensor.txt 파일을 열어 'myFIle'에 넣어 파일을 연결한다.		

	if(myFile) //파일을 여는 데 성공 한 경우(myFile은 파일의 연결 여부를 참, 거짓으로 반환해준다)
	{

		// 최대값, 최소값을 뺀 후 평균을 계산한다.
		sensor_stack -= sensor_max;
		sensor_stack -= sensor_min;
		return_value = sensor_stack / (sensor_stack_count - 2); // 최대값, 최소값을 뺏으므로, 전체 스택 수에서 2를 뺀 후 나눈다.
	

		// 평균 값을 기록
		myFile.print(Sensor_Count);		//파일에 센서 기록 횟수(Sensor_Count)을 쓴다.
		myFile.print("/");  					//파일에 해당 문자를 쓴다.
		myFile.println(return_value);		//파일에 센서의 평균값(return_value)을 쓴다.
		
		myFile.close();						//파일쓰기를 마무리한다. (연결된 파일이 연결해제 된다.)

		Sensor_Count++;					// 센서 순서(Index) 카운트 증가

	} 
	else  // 파일을 여는 데 실패 한 경우
	{
		lcd.setCursor(0,0);		// LCD 커서를 0x0 으로 옮긴다.
		lcd.print("logging error");		// LCD에 해당 문자를 출력한다.
	}
	
	// sensor_2.txt 파일에 필터링된 센서 값, 최대값, 최소값 정보를 기록
	myFile = SD.open("sensor_2.txt", FILE_WRITE);	//현재 연결된 SD카드에서 파일 이어쓰기 모드(FILE_WRITE)로 
														//sensor_2.txt 파일을 열어 'myFIle'에 넣어 파일을 연결한다.

	if(myFile) //파일을 여는 데 성공 한 경우(myFile은 파일의 연결 여부를 참, 거짓으로 반환해준다)
	{
		//필터링된 센서 값 기록
		myFile.print("result : ");		//파일에 해당 문자를 쓴다.
		myFile.print(return_value);		//파일에 return_value(센서의 평균값)를 쓴다.
		
		myFile.print(" / ");  			//파일에 해당 문자를 쓴다.
		
		//최대값 기록
		myFile.print("Max :  ");			//파일에 해당 문자를 쓴다.
		myFile.print(sensor_max);		//파일에 sensor_max(센서의 최대값)를 쓴다.

		myFile.print(" / ");  			//파일에 해당 문자를 쓴다.

		//최소값 기록
		myFile.print("Min :  ");			//파일에 해당 문자를 쓴다.
		myFile.println(sensor_min);	//파일에 sensor_min(센서의 최소값)를 쓴다.

		//다음 순서(Index) 번호 기록
		myFile.print(Sensor_Count);	//파일에 Sensor_Count(센서 기록 횟수)를 쓴다.
		myFile.print("  -  ");			//파일에 해당 문자를 쓴다.

		myFile.close();					//파일쓰기를 마무리한다. (연결된 파일이 연결해제 된다.)
	} 

	//필터링을 위한 관련 함수 초기화
	sensor_stack = 0;					//센서값을 스택을 위한 변수
	sensor_stack_count = 0;			//스택된 센서 값의 갯수를 카운트 하기 위한 변수
	sensor_min = 1023;				//스택된 센서값 중 최소값을 기록하기 위한 변수
	sensor_max = 0;					//스택된 센서값 중 최대값을 기록하기 위한 변수
	return_value = 0;					//스택된 센서값의 평균을 기록하기 위한 변수

}

/*//////////////////////////////////////////////////////////////////////////////////////////////////////////////////////////////////////////////////////
스택, 시리얼 출력 함수(1초 마다 이벤트 발생)
//////////////////////////////////////////////////////////////////////////////////////////////////////////////////////////////////////////////////////*/
void StacknSerial()
{
	// 최대값인지 최소값인지 구별한 후 각자 변수에 대입
	if(sensor_min>sensorValue) sensor_min = sensorValue;		//현재 들어온 센서의 값(sensorValue)이 최소값보다 더 작은 경우 최소값(sensor_min) 넣는다.
	if(sensor_max<sensorValue) sensor_max = sensorValue;		//현재 들어온 센서의 값(sensorValue)이 최대값보다 더 큰 경우 최대값(sensor_max) 넣는다.


	sensor_stack += sensorValue; 	// 들어온 센서 값을 총합(sensor_stack)에 더한다.
	sensor_stack_count++;			// 센서값을 더한 횟수(sensor_stack) 카운트 증가

	
	//컴퓨터 프로그램 사용을 위한 시리얼 포트 출력
	Serial.write("M");					//시리얼 포트로 해당 문자를 출력한다.
	Serial.println(sensorValue);		//시러얼 포트로 현재 들어오는 센서값(sensorValue)을 출력한 후 줄 바꿈 문자열(\n)을 출력한다.

	
	// sensor_2.txt 파일에 들어오는 센서 값 기록 (파일 이어쓰기 모드로 연다.)
	myFile = SD.open("sensor_2.txt", FILE_WRITE);	//현재 연결된 SD카드에서 파일 이어쓰기 모드(FILE_WRITE)로 
														//sensor_2.txt 파일을 열어 'myFIle'에 넣어 파일을 연결한다.


	if(myFile) //파일을 여는 데 성공 한 경우 (myFile은 파일의 연결 여부를 참, 거짓으로 반환해준다)
	{
		myFile.print(sensorValue);		//파일에 현재 센서값(sensorValue)을 쓴다.
		myFile.print("  ");				//파일에 해당 문자를 쓴다.

		myFile.close();					//파일쓰기를 마무리한다. (연결된 파일이 연결해제 된다.)
	} 
}

/*//////////////////////////////////////////////////////////////////////////////////////////////////////////////////////////////////////////////////////
LCD 출력 함수(1초 마다 이벤트 발생)
//////////////////////////////////////////////////////////////////////////////////////////////////////////////////////////////////////////////////////*/
void LCD_Print()
{
	lcd.clear();						// LCD를 클리어 한다.

	lcd.setCursor(0,0);				// LCD 커서를 0x0으로 이동한다.
	lcd.print("Logging Now");		// 해당 문자열을 출력한다.

	lcd.setCursor(0, 1);			// LCD 커서를 0x0으로 이동한다.
	lcd.print("S_Value : ");			// 해당 문자열을 출력한다.

	//현재 센서 값 출력
	lcd.setCursor(11,1);			// LCD 커서를 11x1으로 이동한다.
	lcd.print(sensorValue);		// 현재 센서값(sensorValue)을 출력한다.
}
